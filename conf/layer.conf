## conf/layer.conf
```bitbake
# We have a conf and classes directory, add to BBPATH
BBPATH .= ":${LAYERDIR}"

# We have recipes-* directories, add to BBFILES
BBFILES += "${LAYERDIR}/recipes-*/*/*.bb \
            ${LAYERDIR}/recipes-*/*/*.bbappend"

BBFILE_COLLECTIONS += "meta-heartbeat"
BBFILE_PATTERN_meta-heartbeat = "^${LAYERDIR}/"
BBFILE_PRIORITY_meta-heartbeat = "6"

LAYERDEPENDS_meta-heartbeat = "core"
LAYERSERIES_COMPAT_meta-heartbeat = "dunfell"

# Examples:
# https://stackoverflow.com/questions/49748528/yocto-files-directories-were-installed-but-not-shipped-in-any-package
# https://github.com/CogentEmbedded/meta-opencl/blob/master/meta-ocl-common/recipes-graphics/clblas/clblas_git.bb
```
